## drivers/gpu/arm/Kconfig
```kconfig
#
# (C) COPYRIGHT 2012 ARM Limited. All rights reserved.
#
# This program is free software and is provided to you under the terms of the GNU General Public License version 2
# as published by the Free Software Foundation, and any use by you of this program is subject to the terms of such GNU licence.
#
# A copy of the licence is included with the program, and can also be obtained from Free Software
# Foundation, Inc., 51 Franklin Street, Fifth Floor, Boston, MA  02110-1301, USA.
#
#


menu "ARM GPU Configuration"

menuconfig MALI_THEX
	tristate "Mali support"
	default y
	help
	  Enable this option to build support for the ARM Mali-G72 GPU.

	  To compile this driver as a module, choose M here:
	  this will generate a single module, called mali_kbase.

choice
	prompt "version Configuration"
	depends on MALI_THEX
	default MALI_BIFROST_R35P0 if ANDROID_VERSION >= "100000"
	help
	  Select the gpu support version.

config MALI_BIFROST_R35P0
	depends on MALI_THEX
	bool "Bifrost r35p0 driver for Android"

endchoice

if MALI_BIFROST_R35P0
source "drivers/gpu/arm/b_r35p0/Kconfig"
endif

endmenu
```
